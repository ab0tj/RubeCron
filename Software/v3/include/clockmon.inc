BS:	equ $0008
CR:	equ $000d
CtrlC:	equ $0003
LF:	equ $000a
MID_BASE:	equ $0010
MID_CS:	equ $001a
MID_FMB:	equ $0011
MID_FMBD0:	equ $0012
MID_FMBD1:	equ $0013
MID_FMBD2:	equ $0014
MID_FMBD3:	equ $0015
MID_FMBD4:	equ $0016
MID_FMBD5:	equ $0017
MID_FMBD6:	equ $0018
MID_FMBD7:	equ $0019
MID_MWM:	equ $001c
MID_PD:	equ $001f
MID_SKP:	equ $001b
MID_SKR:	equ $001d
MID_SMB:	equ $0010
MID_ST:	equ $001e
MMU_BASE:	equ $0040
MMU_EN:	equ $0048
MMU_PG0:	equ $0040
MMU_PG1:	equ $0041
MMU_PG2:	equ $0042
MMU_PG3:	equ $0043
PIC_BASE:	equ $0030
SPC:	equ $0020
UART_ACR:	equ $0024
UART_BASE:	equ $0020
UART_CRA:	equ $0022
UART_CRB:	equ $002a
UART_CSRA:	equ $0021
UART_CSRB:	equ $0029
UART_CTL:	equ $0027
UART_CTPL:	equ $0027
UART_CTPU:	equ $0026
UART_CTU:	equ $0026
UART_FIFOA:	equ $0023
UART_FIFOB:	equ $002b
UART_IMR:	equ $0025
UART_IPCR:	equ $0024
UART_IPR:	equ $002d
UART_ISR:	equ $0025
UART_MRA:	equ $0020
UART_MRB:	equ $0028
UART_OPCR:	equ $002d
UART_ROPR:	equ $002f
UART_SOPR:	equ $002e
UART_SPCC:	equ $002f
UART_SRA:	equ $0021
UART_SRB:	equ $0029
UART_STCC:	equ $002e
UART_STF:	equ $002c
UART_UDF:	equ $002c
bin2hex:	equ $fd0c
boot:	equ $faa2
boot_load:	equ $fb4a
boot_load_done:	equ $fb66
chrin:	equ $fd78
crlf:	equ $fd6d
day_led:	equ $0053
dma:	equ $ffef
endmem:	equ $ffff
fill:	equ $fa73
fill_loop:	equ $fa93
fill_next:	equ $fa9d
gps:	equ $fa4e
gps_loop:	equ $fa54
gps_loop_1:	equ $fa63
hex2bin:	equ $fd02
hex2bin1:	equ $fd09
hexnib1:	equ $fcf3
hrs_led:	equ $0052
in_hex:	equ $fcd5
in_hexaddr:	equ $fccc
in_hexnib:	equ $fce4
int_handler:	equ $fe13
int_handler_done:	equ $fe22
int_handler_loop:	equ $fe15
jump:	equ $fa12
lba_adj:	equ $fdf9
memin:	equ $f827
memin_intel:	equ $f894
memin_intel_1:	equ $f8a7
memin_intel_2:	equ $f8d5
memin_intel_cksum:	equ $f8e7
memin_intel_eof:	equ $f8fe
memin_intel_p:	equ $f88d
memin_intel_start:	equ $f897
memin_raw:	equ $f846
memin_raw_1:	equ $f85d
memin_raw_2:	equ $f871
memout:	equ $f911
memout_intel:	equ $f991
memout_intel_1:	equ $f99b
memout_intel_2:	equ $f9aa
memout_intel_3:	equ $f9ac
memout_intel_4:	equ $f9cf
memout_intel_5:	equ $f9e0
memout_intel_6:	equ $f9ea
memout_intel_7:	equ $f9fb
memout_intel_8:	equ $fa09
memout_prompt:	equ $f92c
memout_raw:	equ $f945
memout_raw_1:	equ $f951
memout_raw_2:	equ $f95d
memout_raw_3:	equ $f971
memout_raw_4:	equ $f982
mid_rx:	equ $fe05
mid_xfer:	equ $fe07
mid_xfer_wait:	equ $fe09
min_led:	equ $0051
nmea_dis_end:	equ $f7ac
nmea_dis_loop:	equ $f77d
nmea_match:	equ $fbef
nmi:	equ $fb9d
out_hex:	equ $fd23
out_hexword:	equ $fd38
out_mempos:	equ $fd15
outc:	equ $fd41
outc_b:	equ $fd4c
outstr:	equ $fd62
outstr_b:	equ $fd57
parse_nmea:	equ $fbd9
parse_rmc:	equ $fbf4
parse_rmc_d2:	equ $fc7a
parse_rmc_d3:	equ $fc88
parse_rmc_d4:	equ $fc94
parse_rmc_d5:	equ $fca0
parse_rmc_d6:	equ $fcac
parse_rmc_date:	equ $fc67
parse_rmc_sep:	equ $fc08
parse_rmc_t2:	equ $fc27
parse_rmc_t3:	equ $fc35
parse_rmc_t4:	equ $fc41
parse_rmc_t5:	equ $fc4f
parse_rmc_t6:	equ $fc5b
parse_rmc_time:	equ $fc14
portin:	equ $fa1f
portout:	equ $fa35
program:	equ $fb9a
prompt:	equ $f7d7
rmc_fld:	equ $fffd
rmc_match:	equ $fffb
rmc_pos:	equ $fffe
sd_cap:	equ $ffff
sd_cmd:	equ $fdc0
sd_cmd_wait:	equ $fdde
sd_dummy:	equ $fdb8
sd_error:	equ $fb89
sd_getblock:	equ $fd82
sd_getblock_done:	equ $fdb3
sd_getblock_read:	equ $fda4
sd_getblock_wait:	equ $fd93
sd_init_1:	equ $facc
sd_init_2:	equ $faf7
sd_not_bootable:	equ $fb80
sd_rx:	equ $fde8
sd_rx_1:	equ $fde8
sd_rx_2:	equ $fdf0
sd_setblock:	equ $fb29
sd_std_size:	equ $fb25
sec_led:	equ $0050
set_high_bcd:	equ $fcbd
set_low_bcd:	equ $fcc6
stack:	equ $f700
start:	equ $f700
startmem:	equ $4000
str_addr:	equ $fe83
str_af:	equ $ffc7
str_bc:	equ $ffcb
str_boot:	equ $ff79
str_byte:	equ $feb5
str_ckerr:	equ $fe97
str_crlf:	equ $fe2a
str_de:	equ $ffd0
str_end:	equ $fe7a
str_error:	equ $fec4
str_gprmc:	equ $febd
str_gps:	equ $fee4
str_hexeof:	equ $fe89
str_hextype:	equ $fe5f
str_hl:	equ $ffd5
str_init:	equ $ff4c
str_nmea_cksums:	equ $ff3a
str_nmea_dis:	equ $ff14
str_nmea_msgs:	equ $ff22
str_nosdboot:	equ $ffac
str_pc:	equ $ffda
str_port:	equ $feaf
str_prompt:	equ $fe2d
str_pubx:	equ $ff0a
str_sderr:	equ $ff8e
str_signon:	equ $fe31
str_start:	equ $fe71
str_unsup:	equ $fea2
temp:	equ $fff1
tm_day:	equ $fff8
tm_hrs:	equ $fff5
tm_min:	equ $fff6
tm_mo:	equ $fff9
tm_sec:	equ $fff7
tm_yr:	equ $fffa
